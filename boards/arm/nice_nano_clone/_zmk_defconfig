## boards/arm/nice_nano_clone/_zmk_defconfig
```kconfig
CONFIG_SOC_SERIES_NRF52X=y
CONFIG_SOC_NRF52840_QIAA=y
CONFIG_BOARD_NICE_NANO_CLONE=y

CONFIG_ZMK=y
CONFIG_BT=y
CONFIG_BT_PERIPHERAL=y
CONFIG_BT_CENTRAL=y
CONFIG_BT_SECURITY=y
CONFIG_FLASH=y
CONFIG_FLASH_PAGE_LAYOUT=y
CONFIG_FLASH_AREA_ACCESS=y
CONFIG_MPU_ALLOW_FLASH_WRITE=y
CONFIG_NVS=y
CONFIG_SETTINGS=y
CONFIG_SETTINGS_NVS=y
```

## boards/shields/Split36/Kconfig.defconfig
```kconfig
if SHIELD_SPLIT36_LEFT

config ZMK_KEYBOARD_NAME
    default "Split36"

config ZMK_SPLIT_ROLE_CENTRAL
    default y

endif

if SHIELD_SPLIT36_LEFT || SHIELD_SPLIT36_RIGHT

config ZMK_SPLIT
    default y

config ZMK_POINTING
    default y

config ZMK_SLEEP
    default y

config ZMK_POINTING_SMOOTH_SCROLLING
    default n

endif
```

## config/west.yml
```yaml
manifest:
  remotes:
    - name: molnarc13
      url-base: https://github.com/molnarc13
    - name: badjeff
      url-base: https://github.com/badjeff
  projects:
    - name: zmk
      remote: molnarc13
      revision: split-no-encryption
      import: app/west.yml
    - name: zmk-pmw3610-driver
      remote: badjeff
      revision: main
  self:
    path: config
```
